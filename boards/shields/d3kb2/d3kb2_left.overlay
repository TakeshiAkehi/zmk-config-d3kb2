
#include "d3kb2.dtsi"

&kscan0{
    col-gpios
        = <&gpio0  2 GPIO_ACTIVE_HIGH>
        , <&gpio0  3 GPIO_ACTIVE_HIGH>
        , <&gpio0 28 GPIO_ACTIVE_HIGH>
        , <&gpio0 29 GPIO_ACTIVE_HIGH>
        ; 


    row-gpios
        = <&gpio0  4 (GPIO_ACTIVE_HIGH | GPIO_PULL_DOWN)>
        , <&gpio0  5 (GPIO_ACTIVE_HIGH | GPIO_PULL_DOWN)>
        , <&gpio1 11 (GPIO_ACTIVE_HIGH | GPIO_PULL_DOWN)>
        , <&gpio0  9 (GPIO_ACTIVE_HIGH | GPIO_PULL_DOWN)>
        , <&gpio0 10 (GPIO_ACTIVE_HIGH | GPIO_PULL_DOWN)>
        ;
};

/{
	trackball: virtual_input {
		compatible = "zmk,virtual-input";
	};
};

&encoder{
    compatible = "alps,ec11";
    a-gpios = <&gpio1 15 (GPIO_ACTIVE_HIGH | GPIO_PULL_UP)>;
    b-gpios = <&gpio1 14 (GPIO_ACTIVE_HIGH | GPIO_PULL_UP)>;
    steps = <36>;
    status = "okay";
};


// direct 1.12