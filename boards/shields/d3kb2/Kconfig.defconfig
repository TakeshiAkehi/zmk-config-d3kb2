## boards/shields/d3kb2/Kconfig.defconfig
```kconfig
# Copyright (c) 2021 The ZMK Contributors
# SPDX-License-Identifier: MIT

if SHIELD_D3KB2_RIGHT

config ZMK_KEYBOARD_NAME
    default "d3kb2"

config ZMK_SPLIT_ROLE_CENTRAL
    default y

endif


if SHIELD_D3KB2_LEFT || SHIELD_D3KB2_RIGHT

config ZMK_SPLIT
    default y

endif
```

## boards/shields/d3kb2/Kconfig.shield
```kconfig
# Copyright (c) 2021 The ZMK Contributors
# SPDX-License-Identifier: MIT

config SHIELD_D3KB2_LEFT
    def_bool $(shields_list_contains,d3kb2_left)

config SHIELD_D3KB2_RIGHT
    def_bool $(shields_list_contains,d3kb2_right)
```
